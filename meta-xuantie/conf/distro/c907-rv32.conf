## meta-xuantie/conf/distro/c907-rv32.conf
```bitbake
require conf/distro/include/rv32.inc
require conf/distro/include/mcpu.inc
require conf/distro/include/softfloat.inc
EXTERNAL_TOOLCHAIN_LIB_DIR_NAME = "lib32xthead"

MACHINE = "c907-rv32-tcxt"
XUANTIE_MCPU = "c907-rv32"
```

## meta-xuantie/conf/distro/c907.conf
```bitbake
require conf/distro/include/rv64.inc
require conf/distro/include/mcpu.inc
require conf/distro/include/softfloat.inc

MACHINE = "c907-rv64-tcxt"
XUANTIE_MCPU = "c907"
```

## meta-xuantie/conf/distro/c907fd-rv32.conf
```bitbake
require conf/distro/include/rv32.inc
require conf/distro/include/mcpu.inc
EXTERNAL_TOOLCHAIN_LIB_DIR_NAME = "lib32xthead"

MACHINE = "c907fd-rv32-tcxt"
XUANTIE_MCPU = "c907fd-rv32"
```

## meta-xuantie/conf/distro/c907fdv-rv32.conf
```bitbake
require conf/distro/include/rv32.inc
require conf/distro/include/mcpu.inc
EXTERNAL_TOOLCHAIN_LIB_DIR_NAME = "lib32xthead"

MACHINE = "c907fdv-rv32-tcxt"
XUANTIE_MCPU = "c907fdv-rv32"
```

## meta-xuantie/conf/distro/c907fdvm-rv32.conf
```bitbake
require conf/distro/include/rv32.inc
require conf/distro/include/mcpu.inc
EXTERNAL_TOOLCHAIN_LIB_DIR_NAME = "lib32xthead"

MACHINE = "c907fdvm-rv32-tcxt"
XUANTIE_MCPU = "c907fdvm-rv32"
```

## meta-xuantie/conf/distro/c908-cp_v2.conf
```bitbake
require conf/distro/include/rv64.inc
require conf/distro/include/mcpu.inc
require conf/distro/include/cpu-cp.inc

MACHINE = "c908-cp_v2-rv64-tcxt"
XUANTIE_MCPU = "c908-cp_v2"
```

## meta-xuantie/conf/distro/c908i-cp-xt_v2.conf
```bitbake
require conf/distro/include/rv64.inc
require conf/distro/include/mcpu.inc
require conf/distro/include/softfloat.inc

MACHINE = "c908i-cp-xt_v2-rv64-tcxt"
XUANTIE_MCPU = "c908i-cp-xt_v2"
```

## meta-xuantie/conf/distro/c908i-cp_v2.conf
```bitbake
require conf/distro/include/rv64.inc
require conf/distro/include/mcpu.inc
require conf/distro/include/cpu-cp.inc
require conf/distro/include/softfloat.inc

MACHINE = "c908i-cp_v2-rv64-tcxt"
XUANTIE_MCPU = "c908i-cp_v2"
```

## meta-xuantie/conf/distro/c908i.conf
```bitbake
require conf/distro/include/rv64.inc
require conf/distro/include/mcpu.inc
require conf/distro/include/softfloat.inc

MACHINE = "c908i-rv64-tcxt"
XUANTIE_MCPU = "c908i"
```

## meta-xuantie/conf/distro/c908v-cp_v2.conf
```bitbake
require conf/distro/include/rv64.inc
require conf/distro/include/mcpu.inc

MACHINE = "c908v-cp_v2-rv64-tcxt"
XUANTIE_MCPU = "c908v-cp_v2"
```

## meta-xuantie/conf/distro/c908x.conf
```bitbake
require conf/distro/include/rv64.inc
require conf/distro/include/mcpu.inc

MACHINE = "c908x-rv64-tcxt"
XUANTIE_MCPU = "c908x"
```

## meta-xuantie/conf/distro/c920v3-cp.conf
```bitbake
require conf/distro/include/rv64.inc
require conf/distro/include/mcpu.inc
require conf/distro/include/cpu-cp.inc

MACHINE = "c920v3-cp-rv64-tcxt"
XUANTIE_MCPU = "c920v3-cp"
```

## meta-xuantie/conf/distro/include/clang-benchmarks.inc
```bitbake
TOOLCHAIN:pn-aibench = "clang"
TOOLCHAIN:pn-atomicbench = "clang"
TOOLCHAIN:pn-circustent = "clang"
TOOLCHAIN:pn-coremark = "clang"
TOOLCHAIN:pn-coremark-pro = "clang"
TOOLCHAIN:pn-dhrystone = "clang"
TOOLCHAIN:pn-eembc = "clang"
TOOLCHAIN:pn-iperf2 = "clang"
TOOLCHAIN:pn-iperf3 = "clang"
TOOLCHAIN:pn-linpack = "clang"
TOOLCHAIN:pn-lmbench = "clang"
TOOLCHAIN:pn-nbench = "clang"
TOOLCHAIN:pn-openmpbench = "clang"
TOOLCHAIN:pn-rvv-bench = "clang"
TOOLCHAIN:pn-stream = "clang"
TOOLCHAIN:pn-sysbench = "clang"
TOOLCHAIN:pn-unixbench = "clang"
TOOLCHAIN:pn-whetstone = "clang"
```

## meta-xuantie/conf/distro/include/k6.6ry.inc
```bitbake
PREFERRED_PROVIDER_virtual/kernel ?= "linux-xuantie"
KBUILD_DEFCONFIG ?= "defconfig"

PREFERRED_VERSION_linux-xuantie = "6.6.y"

SERIAL_CONSOLES = "0;console"

XUANTIE_KERNEL_VERSION = "kernel_6.6"
```

## meta-xuantie/conf/distro/include/mcpu-xt-wo-xthead.inc
```bitbake
require conf/distro/include/mcpu.inc

XUANTIE_TUNE_CCARGS_USE_MCPU = "NO"
XUANTIE_TUNE_CCARGS_GENERIC = " ${XUANTIE_NATIVE_TUNE_CCARGS}"
```

## meta-xuantie/conf/distro/include/mcpu.inc
```bitbake
PACKAGE_EXTRA_ARCHS += "${XUANTIE_MCPU} ${XUANTIE_MCPU}_external"
XUANTIE_TUNE_CCARGS_USE_MCPU ?= "YES"
```

## meta-xuantie/conf/distro/include/rv64.inc
```bitbake
require conf/distro/include/xuantie-base.inc

XUANTIE_MCPU ?= "c9xx-riscv64"
PACKAGE_EXTRA_ARCHS += "riscv64 c9xx-riscv64 c9xx-riscv64_external"
XUANTIE_MARCH ?= "rv64imafdc"
XUANTIE_MABI ?= "lp64d"

hostname:pn-base-files = "riscv64-xuantie"
```
