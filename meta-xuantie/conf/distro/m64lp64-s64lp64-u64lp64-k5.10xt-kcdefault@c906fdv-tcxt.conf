## meta-xuantie/conf/distro/r908fdvk-cp.conf
```bitbake
require conf/distro/include/rv64.inc
require conf/distro/include/mcpu.inc
require conf/distro/include/cpu-cp.inc

MACHINE = "r908fdvk-cp-rv64-tcxt"
XUANTIE_MCPU = "r908fdvk-cp"
```

## meta-xuantie/conf/distro/rv64-k5.10-debug@c906fdv.conf
```bitbake
require rv64-k5.10-debug.conf

MACHINE = "riscv64-k5.10xt-kcdebug@c906fdv-tcxt"
KBUILD_DEFCONFIG = "vector_0_7_defconfig"
MACHINE_FEATURES += "kcvector07"
```

## meta-xuantie/conf/distro/rv64-k5.10-default@c906fdv.conf
```bitbake
require rv64-k5.10-default.conf

MACHINE = "riscv64-k5.10xt-kcdefault@c906fdv-tcxt"
KBUILD_DEFCONFIG = "vector_0_7_defconfig"
MACHINE_FEATURES += "kcvector07"
```

## meta-xuantie/conf/distro/rv64-k5.10-default@c908v.conf
```bitbake
require rv64-k5.10-default.conf

MACHINE = "riscv64-k5.10xt-kcdefault@c908v-tcxt"
MACHINE_FEATURES += "kcvlen256"
```

## meta-xuantie/conf/distro/rv64-k5.10-kcdebug@c908v.conf
```bitbake
require rv64-k5.10-debug.conf

MACHINE = "riscv64-k5.10xt-kcdebug@c908v-tcxt"
MACHINE_FEATURES += "kcvlen256"
```

## meta-xuantie/conf/distro/rva23u64-k6.6-debug.conf
```bitbake
require conf/distro/include/rva23u64.inc
require conf/distro/include/k6.6ry.inc
require conf/distro/include/kcdebug.inc

MACHINE ?= "rva23u64-k6.6ry-kcdebug-tcxt"
DEFAULTTUNE = "riscv64"
```

## meta-xuantie/conf/distro/rva23u64-k6.6-default.conf
```bitbake
require conf/distro/include/rva23u64.inc
require conf/distro/include/k6.6ry.inc
require conf/distro/include/kcdefault.inc

MACHINE = "rva23u64-k6.6ry-kcdefault-tcxt"
DEFAULTTUNE = "riscv64"
```

## meta-xuantie/conf/distro/rvb23u64-k6.6-debug.conf
```bitbake
require conf/distro/include/rvb23u64.inc
require conf/distro/include/k6.6ry.inc
require conf/distro/include/kcdebug.inc

MACHINE ?= "rva23u64-k6.6ry-kcdebug-tcxt"
DEFAULTTUNE = "riscv64"
```

## meta-xuantie/conf/distro/rvb23u64-k6.6-default.conf
```bitbake
require conf/distro/include/rvb23u64.inc
require conf/distro/include/k6.6ry.inc
require conf/distro/include/kcdefault.inc

MACHINE = "rva23u64-k6.6ry-kcdefault-tcxt"
DEFAULTTUNE = "riscv64"
```

## meta-xuantie/conf/distro/xt-c925-cp.conf
```bitbake
require conf/distro/include/rvb23u64.inc
require conf/distro/include/mcpu.inc
require conf/distro/include/k6.6ry.inc
require conf/distro/include/kcdefault.inc

MACHINE = "xt-c925-cp-rv64-tcxt"
XUANTIE_MCPU = "xt-c925-cp"
```

## meta-xuantie/conf/distro/xt-c9251fdvkt.conf
```bitbake
require conf/distro/include/rva23u64.inc
require conf/distro/include/mcpu.inc
require conf/distro/include/k6.6ry.inc
require conf/distro/include/kcdefault.inc

MACHINE = "xt-c9251fdvkt-rv64-tcxt"
XUANTIE_MCPU = "xt-c9251fdvkt"
```

## meta-xuantie/conf/distro/xt-c925v-cp.conf
```bitbake
require conf/distro/include/rva23u64.inc
require conf/distro/include/mcpu.inc
require conf/distro/include/k6.6ry.inc
require conf/distro/include/kcdefault.inc

MACHINE = "xt-c925v-cp-rv64-tcxt"
XUANTIE_MCPU = "xt-c925v-cp"
```

## meta-xuantie/conf/distro/xt-c930-cp.conf
```bitbake
require conf/distro/include/rvb23u64.inc
require conf/distro/include/mcpu.inc
require conf/distro/include/k6.6ry.inc
require conf/distro/include/kcdefault.inc

MACHINE = "xt-c930-cp-rv64-tcxt"
XUANTIE_MCPU = "xt-c930-cp"
```

## meta-xuantie/conf/distro/xt-c9501fdvkmt.conf
```bitbake
require conf/distro/include/rva23u64.inc
require conf/distro/include/mcpu.inc
require conf/distro/include/k6.6ry.inc
require conf/distro/include/kcdefault.inc

MACHINE = "xt-c9501fdvkmt-rv64-tcxt"
XUANTIE_MCPU = "xt-c9501fdvkmt"

LD_LIBXTSTRING = "-lxtstring"
```

## meta-xuantie/conf/distro/xt-c950v-cp.conf
```bitbake
require conf/distro/include/rva23u64.inc
require conf/distro/include/mcpu.inc
require conf/distro/include/k6.6ry.inc
require conf/distro/include/kcdefault.inc

MACHINE = "xt-c950v-cp-rv64-tcxt"
XUANTIE_MCPU = "zhijiang"

LD_LIBXTSTRING = "-lxtstring"
```
