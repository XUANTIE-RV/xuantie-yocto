## meta-xuantie/conf/distro/c920v3.conf
```bitbake
require conf/distro/include/rv64.inc
require conf/distro/include/mcpu.inc

MACHINE = "c920v3-rv64-tcxt"
XUANTIE_MCPU = "c920v3"
```

## meta-xuantie/conf/distro/include/k5.10xt.inc
```bitbake
PREFERRED_PROVIDER_virtual/kernel ?= "linux-xuantie"
KBUILD_DEFCONFIG ?= "defconfig"

PREFERRED_VERSION_linux-xuantie = "5.10.y"

SERIAL_CONSOLES = "115200;ttyS0"

# Set OpenSBI version to 0.9 for Kernel 5.10
PREFERRED_VERSION_opensbi = "0.9"

XUANTIE_KERNEL_VERSION = "kernel_5.10"
```

## meta-xuantie/conf/distro/include/rv32.inc
```bitbake
require conf/distro/include/xuantie-base.inc

TUNE_ARCH = "riscv32"
DEFAULTTUNE = "${TUNE_ARCH}"
EXTERNAL_TARGET_SYS = "riscv64-linux"
XUANTIE_MCPU ?= "c9xx-riscv32"
PACKAGE_EXTRA_ARCHS += "riscv32 c9xx-riscv32"
XUANTIE_MARCH ?= "rv32imafdc"
XUANTIE_MABI ?= "ilp32d"
EXTERNAL_TOOLCHAIN_LIB_DIR_NAME ?= "lib32"

hostname:pn-base-files = "riscv32-xuantie"
```

## meta-xuantie/conf/distro/r908fd-cp.conf
```bitbake
require conf/distro/include/rv64.inc
require conf/distro/include/mcpu.inc

MACHINE = "r908fd-cp-rv64-tcxt"
XUANTIE_MCPU = "r908fd-cp"
```

## meta-xuantie/conf/distro/r908fdv-cp.conf
```bitbake
require conf/distro/include/rv64.inc
require conf/distro/include/mcpu.inc

MACHINE = "r908fdv-cp-rv64-tcxt"
XUANTIE_MCPU = "r908fdv-cp"
```

## meta-xuantie/conf/distro/r908fdv.conf
```bitbake
require conf/distro/include/rv64.inc
require conf/distro/include/mcpu.inc

MACHINE = "r908fdv-rv64-tcxt"
XUANTIE_MCPU = "r908fdv"
```

## meta-xuantie/conf/distro/rv32-k5.10-default.conf
```bitbake
require conf/distro/include/rv32.inc
require conf/distro/include/k5.10xt.inc
require conf/distro/include/kcdefault.inc

MACHINE ?= "riscv32-k5.10xt-kcdefault-tcxt"
```

## meta-xuantie/conf/distro/rv64-k6.6-default.conf
```bitbake
require conf/distro/include/rv64.inc
require conf/distro/include/k6.6ry.inc
require conf/distro/include/kcdefault.inc

MACHINE = "riscv64-k6.6ry-kcdefault-tcxt"
DEFAULTTUNE = "riscv64"
```

## meta-xuantie/conf/distro/thead-c910.conf
```bitbake
DISTRO = "thead-c910"
DISTRO_NAME = "THEAD C910 Release Distro"
DISTRO_VERSION = "0.9.5.1"
```

## openembedded-core/meta/conf/machine/include/csky/arch-csky.inc
```bitbake
# csky Architecture definition

DEFAULTTUNE ?= "csky32"

TUNE_ARCH = "${TUNE_ARCH:tune-${DEFAULTTUNE}}"
TUNE_PKGARCH = "${TUNE_PKGARCH:tune-${DEFAULTTUNE}}"
#TUNE_CCARGS:append = "${@bb.utils.contains('TUNE_FEATURES', 'csky32nf', ' -mabi=ilp32', ' ', d)}"

# QEMU usermode fails with invalid instruction error (For riscv32)
MACHINE_FEATURES_BACKFILL_CONSIDERED:append = "${@bb.utils.contains('TUNE_FEATURES', 'csky32', ' qemu-usermode', '', d)}"

# Fix: ld: unrecognized option '--hash-style=sysv'
LINKER_HASH_STYLE:libc-newlib = ""
# Fix: ld: unrecognized option '--hash-style=gnu'
LINKER_HASH_STYLE:libc-baremetal = ""
```

## openembedded-core/meta/conf/machine/include/csky/tune-csky.inc
```bitbake
require conf/machine/include/csky/arch-csky.inc

TUNEVALID[csky32] = "Enable 32-bit CSKY optimizations"

TUNEVALID[bigendian] = "Big endian mode"

AVAILTUNES += "csky"

# Default
TUNE_FEATURES:tune-csky32 = "csky32"
TUNE_ARCH:tune-csky32 = "csky32"
TUNE_PKGARCH:tune-csky32 = "csky32"
PACKAGE_EXTRA_ARCHS:tune-csky32 = "csky32"
```

## xuantie-build/xuantie/conf/bblayers.conf
```bitbake
# LAYER_CONF_VERSION is increased each time build/conf/bblayers.conf
# changes incompatibly
LCONF_VERSION = "7"

BBPATH = "${TOPDIR}"
BBFILES ?= ""

# YOCTOROOT ="${@os.path.abspath(os.path.join(os.path.join("${TOPDIR}", os.pardir), os.pardir))}"
YOCTOROOT ="${@os.path.abspath("${TOPDIR}/../../")}"

BBLAYERS ?= " \
  ${YOCTOROOT}/openembedded-core/meta \
  ${YOCTOROOT}/meta-openembedded/meta-filesystems \
  ${YOCTOROOT}/meta-openembedded/meta-networking \
  ${YOCTOROOT}/meta-openembedded/meta-perl \
  ${YOCTOROOT}/meta-openembedded/meta-oe \
  ${YOCTOROOT}/meta-external-toolchain \
  ${YOCTOROOT}/meta-riscv \
  ${YOCTOROOT}/meta-xuantie \
  ${YOCTOROOT}/meta-k230 \
"
```
