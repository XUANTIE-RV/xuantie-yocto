		/* mtimer, also known as "riscv,aclint-mtimer", has been removed. Since sstc remains, it does not affect booting. */

		intc: aplic@8004000 {
			riscv,num-sources = <0x60>;
			reg = <0x00 0x8004000 0x00 0x4000>;
			msi-parent = <&imsics_s>;
			interrupt-controller;
			#interrupt-cells = <0x02>;
			compatible = "riscv,aplic";
		};

		aplic_m: aplic@8000000 {
			riscv,delegate = <&intc 0x01 0x60>;
			riscv,children = <&intc>;
			riscv,num-sources = <0x60>;
			reg = <0x00 0x8000000 0x00 0x4000>;
			msi-parent = <&imsics_m>;
			interrupt-controller;
			#interrupt-cells = <0x02>;
			compatible = "riscv,aplic";
		};

		imsics_m: imsics@f00000000000 {
			riscv,num-ids = <0xff>;
			reg = <0xf000 0x00 0x00 0x10000>;
			interrupts-extended = <
				&cpu0_intc 11 &cpu1_intc 11
				&cpu2_intc 11 &cpu3_intc 11
				&cpu4_intc 11 &cpu5_intc 11
				&cpu6_intc 11 &cpu7_intc 11
				&cpu8_intc 11 &cpu9_intc 11
				&cpu10_intc 11 &cpu11_intc 11
				&cpu12_intc 11 &cpu13_intc 11
				&cpu14_intc 11 &cpu15_intc 11
			>;
			msi-controller;
			interrupt-controller;
			#interrupt-cells = <0x00>;
			compatible = "riscv,imsics";
		};

		imsics_s: imsics@f00010000000 {
			riscv,guest-index-bits = <0x06>;
			riscv,num-ids = <0xff>;
			reg = <0xf000 0x10000000 0x00 0x400000>;
			interrupts-extended = <
				&cpu0_intc 9 &cpu1_intc 9
				&cpu2_intc 9 &cpu3_intc 9
				&cpu4_intc 9 &cpu5_intc 9
				&cpu6_intc 9 &cpu7_intc 9
				&cpu8_intc 9 &cpu9_intc 9
				&cpu10_intc 9 &cpu11_intc 9
				&cpu12_intc 9 &cpu13_intc 9
				&cpu14_intc 9 &cpu15_intc 9
			>;
			msi-controller;
			interrupt-controller;
			#interrupt-cells = <0x00>;
			compatible = "riscv,imsics";
		};
