## meta-external-toolchain/conf/layer.conf
```bitbake
BBPATH .= ":${LAYERDIR}"
BBFILES += "${LAYERDIR}/recipes-*/*/*.bb \
            ${LAYERDIR}/recipes-*/*/*.bbappend"
BBFILE_COLLECTIONS += "external-toolchain"
BBFILE_PRIORITY_external-toolchain = "1"
BBFILE_PATTERN_external-toolchain = "^${LAYERDIR}/"

LAYERDEPENDS_external-toolchain = "core"
LAYERSERIES_COMPAT_external-toolchain = "kirkstone langdale"
LAYERDIR_external-toolchain = "${LAYERDIR}"

BBFILES += "${@' '.join('${LAYERDIR}/%s/recipes*/*/*.%s' % (layer, ext) \
               for layer in '${BBFILE_COLLECTIONS}'.split() for ext in ['bb', 'bbappend'])}"

# These will rebuild when EXTERNAL_TOOLCHAIN changes, but we don't want
# everything to rebuild in such a case.
SIGGEN_EXCLUDERECIPES_ABISAFE += "\
    gcc-external-cross \
    gcc-external-cross-${TARGET_ARCH} \
    binutils-external-cross  \
    binutils-external-cross-${TARGET_ARCH} \
"

# Needed for external_run() for PV & LICENSE in the recipes, to be able to parse
INHERIT:append = " external_global"

# Fallback default for when the tcmode isn't sourced
GCC_VERSION ?= "0.0"
```

## meta-light/conf/machine/include/thead-base.inc
```bitbake
require conf/machine/include/riscv/tune-riscv.inc

EXTERNAL_TOOLCHAIN ?= "${TOPDIR}/../../riscv-toolchain"
TCMODE="external"
TARGET_PREFIX="riscv64-linux-"
TARGET_ARCH="riscv64"
TARGET_OS="linux"
QEMU_TOOLCHAIN_PATH="${TOPDIR}/../../riscv-toolchain/csky-qemu/bin/"
SYSROOT_PREFIX ??= " riscv64-buildroot-linux-gnu"
EXTERNAL_TOOLCHAIN_SYSROOT="${EXTERNAL_TOOLCHAIN}/${SYSROOT_PREFIX}/sysroot"

INSANE_SKIP_${PN} += "glibc-so gobject-introspection-so glibc-external"

PREFERRED_PROVIDER_virtual/kernel ?= "linux-thead"
PREFERRED_PROVIDER_virtual/bootloader ?= "u-boot"
PREFERRED_VERSION_openocd-native = "riscv"
PREFERRED_VERSION_openocd = "riscv"

# KERNEL_CLASSES  = "kernel-uimage"
# KERNEL_IMAGETYPES = "itbImage"

KERNEL_IMAGETYPE = "Image"
KERNEL_IMAGETYPES += "uImage"
KEEPUIMAGE = "no"

# MACHINE_FEATURES = "usbgadget usbhost vfat alsa touchscreen"
MACHINE_FEATURES = "screen keyboard ext2 ext3 serial"

## This sets u-boot as the default OpenSBI payload
RISCV_SBI_PAYLOAD ?= "u-boot.bin"

EXTRA_IMAGEDEPENDS += "opensbi"
RISCV_SBI_PLAT = "thead/c910"

EXTRA_IMAGEDEPENDS += "u-boot"
UBOOT_MACHINE = "qemu-riscv64_defconfig"

## Do not update fstab file when using wic images
WIC_CREATE_EXTRA_ARGS ?= "--no-fstab-update"

## wic default support
WKS_FILE_DEPENDS ?= " \
    opensbi \
    e2fsprogs-native \
    bmap-tools-native \
"

IMAGE_BOOT_FILES ?= " \
    fw_payload.bin \
    fitImage \
    boot.scr.uimg \
"

WKS_FILE ?= "xuantie-opensbi.wks"

BAD_RECOMMENDATIONS += "\
    libcxx-dev \
    libcxx-staticdev \
    compiler-rt-dev \
    compiler-rt-staticdev \
"
ASSUME_PROVIDED += "\
    libcxx-dev \
    libcxx-staticdev \
    compiler-rt-dev \
    compiler-rt-staticdev \
"
```

## meta-light/conf/machine/light-a-public-release.conf
```bitbake
#@TYPE: Machine
#@NAME: xuantie
#@SOC: XuanTie Light
#@DESCRIPTION: Machine configuration for the Light A validation board

require conf/machine/include/thead-base.inc

SERIAL_CONSOLES = "115200;ttyS0"
MACHINE_EXTRA_RRECOMMENDS += "kernel-modules"

IMAGE_FSTYPES += "cpio.gz ext4"

# Uncomment the following two lines to always checkout the specified version of each repository
THEAD_BSP_TAG = "Linux_SDK_V0.9.5"
THEAD_LINUX_TAG = "Linux_SDK_V0.9.5"

# 指定u-boot版本
PREFERRED_PROVIDER_virtual/bootloader ?= "u-boot"
PREFERRED_VERSION_u-boot = "1:2020.10"
# UBOOT_MACHINE ?= "light_defconfig"
UBOOT_MACHINE = "light_a_val_defconfig"
SPL_BINARY = "spl/u-boot-spl"
UBOOT_ELF = "u-boot"
UBOOT_BINARY = "u-boot-with-spl.bin"


# 指定内核版本
PREFERRED_PROVIDER_virtual/kernel ?= "linux-thead"
PREFERRED_VERSION_linux-thead = "5.10.y"
KERNEL_DEVICETREE_light-a-public-release ?= "thead/light-a-val.dtb thead/light-a-val-ddr2G.dtb thead/light-a-val-ddr1G.dtb thead/light-a-val-wcn.dtb thead/light-a-val-dsi0.dtb thead/light-a-val-dsi1.dtb thead/light-a-val-hdmi.dtb thead/light-a-val-dsi0-dsi1.dtb thead/light-a-val-dsi0-hdmi.dtb thead/light-a-val-audio.dtb thead/light-a-val-iso7816.dtb thead/light-a-val-npu-fce.dtb thead/light-a-val-sv.dtb thead/light-a-val-nand.dtb thead/light-a-val-dsp0-dsp1.dtb thead/light-a-val-dpi0.dtb thead/light-a-val-dpi0-dpi1.dtb thead/light-a-val-miniapp-hdmi.dtb thead/light-a-val-gpio-keys.dtb thead/light-a-val-sec.dtb thead/light-a-val-full.dtb thead/light-a-val-khv.dtb"
KERNEL_DEVICETREE_light-a-public-release += " thead/light-a-val-powergate.dtb thead/light-a-val-ddr2G-powergate.dtb thead/light-a-val-ddr1G.dtb thead/light-a-val-wcn-powergate.dtb thead/light-a-val-dsi0-powergate.dtb thead/light-a-val-dsi1-powergate.dtb thead/light-a-val-hdmi-powergate.dtb thead/light-a-val-dsi0-dsi1-powergate.dtb thead/light-a-val-dsi0-hdmi-powergate.dtb thead/light-a-val-audio-powergate.dtb thead/light-a-val-iso7816-powergate.dtb thead/light-a-val-npu-fce-powergate.dtb thead/light-a-val-sv-powergate.dtb thead/light-a-val-nand-powergate.dtb thead/light-a-val-dsp0-dsp1-powergate.dtb thead/light-a-val-dpi0-powergate.dtb thead/light-a-val-dpi0-dpi1-powergate.dtb thead/light-a-val-miniapp-hdmi-powergate.dtb thead/light-a-val-sec-powergate.dtb thead/light-a-val-full-powergate.dtb thead/light-a-val-khv-powergate.dtb"
KBUILD_DEFCONFIG_light-a-public-release = "light_defconfig"
```

## meta-riscv/conf/machine/d1.conf
```bitbake
#@TYPE: Machine
#@NAME: xuantie
#@SOC: Allwinner D1
#@DESCRIPTION: Machine configuration for the HiFive Unleashed development board

require conf/machine/include/thead-base.inc

SERIAL_CONSOLES = "115200;ttyS0"
MACHINE_EXTRA_RRECOMMENDS += "kernel-modules"

IMAGE_FSTYPES += "cpio.gz"

# 指定u-boot版本
PREFERRED_PROVIDER_virtual/bootloader ?= "u-boot"
PREFERRED_VERSION_u-boot = "1:2018.05"
UBOOT_MACHINE = "d1_defconfig"
UBOOT_ENTRYPOINT = "0x80200000"
UBOOT_DTB_LOADADDRESS = "0x82200000"

# 指定内核版本
PREFERRED_PROVIDER_virtual/kernel ?= "linux-thead"
PREFERRED_VERSION_linux-thead = "5.4.61"
KERNEL_DEVICETREE ?= "sunxi/d1.dtb"
KBUILD_DEFCONFIG_d1 ?= "d1_minimal_defconfig"
```

## meta-riscv/conf/machine/ice.conf
```bitbake
#@TYPE: Machine
#@NAME: xuantie
#@SOC: XuanTie ICE
#@DESCRIPTION: Machine configuration for the ICE development board

require conf/machine/include/thead-base.inc

SERIAL_CONSOLES = "115200;ttyS1"
MACHINE_EXTRA_RRECOMMENDS += "kernel-modules"

IMAGE_FSTYPES += "cpio.gz ext4"

# 指定u-boot版本
PREFERRED_PROVIDER_virtual/bootloader ?= "u-boot"
PREFERRED_VERSION_u-boot = "1:2020.10"
UBOOT_MACHINE = "ice_evb_c910_defconfig"
SPL_BINARY = "spl/u-boot-spl"
UBOOT_ELF = "u-boot"
UBOOT_BINARY = "u-boot-with-spl.bin"

# 指定内核版本
PREFERRED_PROVIDER_virtual/kernel ?= "linux-thead"
PREFERRED_VERSION_linux-thead = "5.10.4"
KERNEL_DEVICETREE ?= "thead/ice.dtb"
KBUILD_DEFCONFIG_ice = "ice_defconfig"
```

## meta-virtualization/conf/distro/include/meta-virt-default-versions.inc
```bitbake
# Meta-virtuailization PREFERED_VERSION

PREFERRED_VERSION_xen ?= "4.16+stable%"
PREFERRED_VERSION_xen-tools ?= "4.16+stable%"
```

## meta-virtualization/conf/distro/include/meta-virt-xen.inc
```bitbake
# Make sure Xen mode is enabled in qemu
PACKAGECONFIG:append:pn-qemu = " xen"

# For builds for ARM platforms, enable fdt
PACKAGECONFIG:append:pn-qemu:arm = " fdt"
PACKAGECONFIG:append:pn-qemu:aarch64 = " fdt"

# Xen on Raspberry Pi 4 64-bit support
XEN_RPI4_64_CONFIG_PATH ??= \
    'dynamic-layers/raspberrypi/conf/distro/include/xen-raspberrypi4-64.inc'
include ${@bb.utils.contains('MACHINE', 'raspberrypi4-64', \
    '${XEN_RPI4_64_CONFIG_PATH}', '', d)}

# Set serial for working qemuboot console
SERIAL_CONSOLES:qemuarm64 ?= "115200;ttyAMA0"
```

## meta-virtualization/conf/distro/include/virt_security_flags.inc
```bitbake
# Build errors with the pie options enabled
SECURITY_CFLAGS:pn-libvirt = "${SECURITY_NO_PIE_CFLAGS}"

# This has text relco errors with the pie options enabled
SECURITY_CFLAGS:pn-lxc = "${SECURITY_NO_PIE_CFLAGS}"
```

## meta-virtualization/conf/layer.conf
```bitbake
# We have a conf and classes directory, append to BBPATH
BBPATH .= ":${LAYERDIR}"

# We have a recipes directory, add to BBFILES
BBFILES += "${LAYERDIR}/recipes*/*/*.bb ${LAYERDIR}/recipes*/*/*.bbappend"

BBFILE_COLLECTIONS += "virtualization-layer"
BBFILE_PATTERN_virtualization-layer := "^${LAYERDIR}/"
BBFILE_PRIORITY_virtualization-layer = "8"

# Custom licenses used by some packages in this layer
LICENSE_PATH += "${LAYERDIR}/files/custom-licenses"

BBFILES_DYNAMIC += " \
    raspberrypi:${LAYERDIR}/dynamic-layers/raspberrypi/*/*/*.bb \
    raspberrypi:${LAYERDIR}/dynamic-layers/raspberrypi/*/*/*.bbappend \
    xilinx:${LAYERDIR}/dynamic-layers/xilinx/*/*/*.bb \
    xilinx:${LAYERDIR}/dynamic-layers/xilinx/*/*/*.bbappend \
"

# This should only be incremented on significant changes that will
# cause compatibility issues with other layers
LAYERVERSION_virtualization-layer = "1"
LAYERSERIES_COMPAT_virtualization-layer = "langdale"
LAYERDEPENDS_virtualization-layer = " \
    core \
    openembedded-layer \
    networking-layer \
    filesystems-layer \
    meta-python \
"

# webserver: naigos requires apache2
LAYERRECOMMENDS_virtualization-layer = " \
    webserver \
    selinux \
"

# Override security flags
require conf/distro/include/virt_security_flags.inc

PREFERRED_PROVIDER_virtual/runc ?= "runc-opencontainers"
PREFERRED_PROVIDER_virtual/containerd ?= "containerd-opencontainers"
PREFERRED_PROVIDER_virtual/docker ?= "docker-ce"

# Sanity check for meta-virtualization layer.
# Setting SKIP_META_VIRT_SANITY_CHECK to "1" would skip the bbappend files check.
INHERIT += "sanity-meta-virt"

# We need to load the meta-virt config components, only if "virtualization"
# is in the distro features.  Since we don't know the distro flags during
# layer.conf load time, we delay using a special bbclass that simply includes
# the META_VIRT_CONFIG_PATH file, and likewise for the Xen and k8s configs
META_VIRT_CONFIG_PATH = "${LAYERDIR}/conf/distro/include/meta-virt-default-versions.inc"
META_VIRT_XEN_CONFIG_PATH = "${LAYERDIR}/conf/distro/include/meta-virt-xen.inc"
K8S_CONFIG_PATH = "${LAYERDIR}/conf/distro/include/k8s-versions.inc"
USER_CLASSES:append = " meta-virt-cfg"
USER_CLASSES:append = " meta-virt-k8s-cfg"
USER_CLASSES:append = " meta-virt-xen-cfg"
USER_CLASSES:append = " meta-virt-hosts"

HOSTTOOLS_NONFATAL += "getent"
```

## meta-virtualization/dynamic-layers/raspberrypi/conf/distro/include/xen-raspberrypi4-64.inc
```bitbake
# Xen on Raspberry Pi 4 settings

# Xen uses u-boot for configuration and uses the uart
RPI_USE_U_BOOT = "1"
ENABLE_UART = "1"

# Build the bootable SD card image
IMAGE_CLASSES:append = " sdcard_image-rpi"
IMAGE_FSTYPES:append = " rpi-sdimg"

# Add Xen to the bootable SD card image
RPI_SDIMG_EXTRA_DEPENDS:append = " xen:do_deploy"
DEPLOYPAYLOAD = "xen-${MACHINE}:xen"

# We need the GIC enabled for Xen to work
RPI_EXTRA_CONFIG:append  = "\nenable_gic=1"

# Increase boot partition for space for kernel and Xen
BOOT_SPACE = "61440"

# Override the meta-raspberrypi default kernel preference
PREFERRED_PROVIDER_virtual/kernel ?= "linux-yocto"
KERNEL_DEVICETREE ?= "broadcom/bcm2711-rpi-4-b.dtb"

PREFERRED_PROVIDER_u-boot-default-script ?= "xen-rpi-u-boot-scr"
```

## meta-virtualization/wic/directdisk-xen.wks
```
# short-description: Create a 'pcbios' direct disk image with Xen hypervisor
# long-description: Creates a partitioned legacy BIOS disk image to boot Xen
# that the user can directly dd to boot media. Boot files are located on the
# first vfat partition.

part /boot --source bootimg-biosxen --ondisk sda --label boot --active --align 1024

# For the main partition, it can be useful to add additional space for VMs:
# eg. increase partition size by appending: --size 10G
part / --source rootfs --ondisk sda --use-uuid --fstype=ext4 --label root --align 1024
```

## meta-virtualization/wic/qemuboot-xen-x86-64.wks
```
# short-description: Create a 'pcbios' direct disk image with Xen hypervisor and bootloader config
# long-description: Creates a partitioned legacy BIOS disk image to boot Xen
# with a bootloader config that the user can directly dd to boot media.
# Boot files are located on the first vfat partition.

part /boot --source bootimg-biosxen --ondisk sda --label boot --active --align 1024

# For the main partition, it can be useful to add additional space for VMs;
# eg. increase partition size by appending: --size 10G
part / --source rootfs --ondisk sda --use-uuid --fstype=ext4 --label root --align 1024

bootloader --configfile="qemuboot-xen-x86-64.cfg"
```

## meta-xuantie/conf/distro/c906fd.conf
```bitbake
require conf/distro/include/rv64.inc
require conf/distro/include/mcpu.inc

MACHINE = "c906fd-rv64-tcxt"
XUANTIE_MCPU = "c906fd"
```

## meta-xuantie/conf/distro/c906fdv.conf
```bitbake
require conf/distro/include/rv64.inc
require conf/distro/include/mcpu.inc

MACHINE = "c906fdv-rv64-tcxt"
XUANTIE_MCPU = "c906fdv"
```

## meta-xuantie/conf/distro/c907fdv.conf
```bitbake
require conf/distro/include/rv64.inc
require conf/distro/include/mcpu.inc

MACHINE = "c907fdv-rv64-tcxt"
XUANTIE_MCPU = "c907fdv"
```

## meta-xuantie/conf/distro/c907fdvm.conf
```bitbake
require conf/distro/include/rv64.inc
require conf/distro/include/mcpu.inc

MACHINE = "c907fdvm-rv64-tcxt"
XUANTIE_MCPU = "c907fdvm"
```

## meta-xuantie/conf/distro/c908.conf
```bitbake
require conf/distro/include/rv64.inc
require conf/distro/include/mcpu.inc

MACHINE = "c908-rv64-tcxt"
XUANTIE_MCPU = "c908"
```

## meta-xuantie/conf/distro/c908v.conf
```bitbake
require conf/distro/include/rv64.inc
require conf/distro/include/mcpu.inc

MACHINE = "c908v-rv64-tcxt"
XUANTIE_MCPU = "c908v"
```

## meta-xuantie/conf/distro/c910.conf
```bitbake
require conf/distro/include/rv64.inc
require conf/distro/include/mcpu.inc

MACHINE = "c910-rv64-tcxt"
XUANTIE_MCPU = "c910"
```

## meta-xuantie/conf/distro/c910v2.conf
```bitbake
require conf/distro/include/rv64.inc
require conf/distro/include/mcpu.inc

MACHINE = "c910v2-rv64-tcxt"
XUANTIE_MCPU = "c910v2"
```

## meta-xuantie/conf/distro/c920.conf
```bitbake
require conf/distro/include/rv64.inc
require conf/distro/include/mcpu.inc

MACHINE = "c920-rv64-tcxt"
XUANTIE_MCPU = "c920"
```
