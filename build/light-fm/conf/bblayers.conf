## build/light-fm/conf/bblayers.conf
```bitbake
# LAYER_CONF_VERSION is increased each time build/conf/bblayers.conf
# changes incompatibly
LCONF_VERSION = "7"

BBPATH = "${TOPDIR}"
BBFILES ?= ""

# YOCTOROOT ="${@os.path.abspath(os.path.join(os.path.join("${TOPDIR}", os.pardir), os.pardir))}"
YOCTOROOT ="${@os.path.abspath("${TOPDIR}/../../")}"

BBLAYERS ?= " \
  ${YOCTOROOT}/openembedded-core/meta \
  ${YOCTOROOT}/meta-openembedded/meta-oe \
  ${YOCTOROOT}/meta-openembedded/meta-python \
  ${YOCTOROOT}/meta-openembedded/meta-multimedia \
  ${YOCTOROOT}/meta-openembedded/meta-networking \
  ${YOCTOROOT}/meta-external-toolchain \
  ${YOCTOROOT}/meta-riscv \
  ${YOCTOROOT}/meta-thead \
  ${YOCTOROOT}/meta-light \
  ${YOCTOROOT}/meta-openembedded/meta-gnome \
  ${YOCTOROOT}/meta-openembedded/meta-filesystems \
  ${YOCTOROOT}/meta-openembedded/meta-webserver \
  "
```

## meta-external-toolchain/conf/distro/include/tcmode-external-oe-sdk.inc
```bitbake
require conf/distro/include/tcmode-external.inc

# OE-built toolchains default to this, so don't pass it explicitly
TARGET_LDFLAGS_BUILD_ID = ""

# OE-built toolchains assume en_US is utf8
EXTERNAL_TOOLCHAIN_FEATURES_DEFAULT ??= "locale-utf8-is-default"

TCMODEOVERRIDES .= ":tcmode-external-oe-sdk"

EXTERNAL_TARGET_SYS ?= "${TARGET_SYS}"

EXTERNAL_SDK_SYS ?= "${SDK_SYS}"
EXTERNAL_TOOLCHAIN_BIN = "${EXTERNAL_TOOLCHAIN}/sysroots/${EXTERNAL_SDK_SYS}/usr/bin/${EXTERNAL_TARGET_SYS}"
EXTERNAL_MULTIMACH_TARGET_SYS ?= "${MULTIMACH_TARGET_SYS}"
EXTERNAL_TOOLCHAIN_SYSROOT = "${EXTERNAL_TOOLCHAIN}/sysroots/${EXTERNAL_MULTIMACH_TARGET_SYS}"

EXTERNAL_CC = "${EXTERNAL_TARGET_SYS}-gcc --sysroot=${EXTERNAL_TOOLCHAIN_SYSROOT}"
EXTERNAL_TOOLCHAIN_FEATURES:append = " locale-utf8-is-default"

EXTERNAL_SETUP_SCRIPT_VARS ?= ""

# Our headers are already multilib
oe_multilib_header:pn-glibc-external = ":"

EXTERNAL_TOOLCHAINS ??= "${EXTERNAL_TOOLCHAIN}"

python extract_env_setup_metadata() {
    from pathlib import Path

    paths = [Path(p) for p in d.getVar('EXTERNAL_TOOLCHAINS').split()]
    paths = [p for p in paths if p.is_absolute() and p.is_dir()]
    if paths:
        setup_external_vars(paths, d, d)

        localdata = bb.data.createCopy(d)
        variants = d.getVar('MULTILIB_VARIANTS') or ''
        for item in variants.split():
            # Load overrides from 'd' to avoid having to reset the value...
            overrides = d.getVar('OVERRIDES', False) + ':virtclass-multilib-' + item
            localdata.setVar('OVERRIDES', overrides)
            localdata.setVar('MLPREFIX', item + '-')
            setup_external_vars(paths, localdata, d)
}
extract_env_setup_metadata[eventmask] = "bb.event.ConfigParsed"
addhandler extract_env_setup_metadata

def setup_external_vars(paths, localdata, d):
    from pathlib import Path

    setup, env = get_setup_script_env(paths, localdata)

    mlprefix = localdata.getVar('MLPREFIX')
    if mlprefix:
        suffix = '_virtclass-multilib-' + mlprefix[:-1]
    else:
        suffix = ''

    d.setVar('EXTERNAL_TOOLCHAIN' + suffix, str(setup.parent))

    for var in localdata.getVar('EXTERNAL_SETUP_SCRIPT_VARS').split():
        d.setVar('EXTERNAL_' + var + suffix, env.get(var) or '')

    target_sys = env.get('TARGET_PREFIX')[:-1]
    native_sysroot = Path(env.get('OECORE_NATIVE_SYSROOT'))
    if str(native_sysroot).startswith('$scriptdir/'):
        native_sysroot = setup.parent / native_sysroot.relative_to('$scriptdir')
    target_sysroot = Path(env.get('SDKTARGETSYSROOT'))
    if str(target_sysroot).startswith('$scriptdir/'):
        target_sysroot = setup.parent / target_sysroot.relative_to('$scriptdir')

    d.setVar('EXTERNAL_TARGET_SYS' + suffix, str(target_sys))
    d.setVar('EXTERNAL_TOOLCHAIN_BIN' + suffix, str(native_sysroot / 'usr' / 'bin' / target_sys))
    d.setVar('EXTERNAL_TOOLCHAIN_SYSROOT' + suffix, str(target_sysroot))

# These are treated as prefixes to items in PACKAGE_ARCHS at this time.
#
# An armv7-a sysroot will run fine with armv7ve machines, as the latter just
# have virtualization extensions. We need to handle this sort of thing
# directly in this case, as for some reason the armv7-a tunes aren't listed in
# the armv7ve PACKAGE_ARCHS.
EXTERNAL_TOOLCHAIN_ARCH_COMPAT[armv7ve] += "armv7a"

def select_appropriate_setup_script(d, paths):
    from itertools import chain
    from pathlib import Path

    candidates = []

    tune_pkgarch = d.getVar('TUNE_PKGARCH')
    arch_setups = list(chain.from_iterable(Path(path).glob('environment-setup-' + tune_pkgarch + '-*') for path in paths))
    if arch_setups:
        # Exact match, skip processing
        for setup in arch_setups:
            setup_env = parse_setup_script(setup)
            candidates.append((setup, setup_env))
        return candidates

    target_arch = d.getVar('TARGET_ARCH')
    target_os = d.getVar('TARGET_OS')
    baselib = d.getVar('baselib')
    package_archs = d.getVar('PACKAGE_ARCHS').split()

    arch_compat = d.getVarFlags('EXTERNAL_TOOLCHAIN_ARCH_COMPAT')
    setups = chain.from_iterable(Path(path).glob('environment-setup-*') for path in paths)
    for setup in setups:
        setup_env = parse_setup_script(setup)
        if target_arch != setup_get(setup_env, 'OECORE_TARGET_ARCH'):
            bb.debug(1, "tcmode-external-oe-sdk: TARGET_ARCH `{}` doesn't match `{}` in `{}`".format(target_arch, setup_get(setup_env, 'OECORE_TARGET_ARCH'), setup))
            continue
        if target_os != setup_get(setup_env, 'OECORE_TARGET_OS'):
            bb.debug(1, "tcmode-external-oe-sdk: TARGET_OS `{}` doesn't match `{}` in `{}`".format(target_os, setup_get(setup_env, 'OECORE_TARGET_OS'), setup))
            continue
        if baselib != setup_get(setup_env, 'OECORE_BASELIB'):
            bb.debug(1, "tcmode-external-oe-sdk: BASELIB `{}` doesn't match `{}` in `{}`".format(baselib, setup_get(setup_env, 'OECORE_BASELIB'), setup))
            continue

        setup_tune_pkgarch = setup_env.get('TUNE_PKGARCH')
        if setup_tune_pkgarch:
            if setup_tune_pkgarch not in package_archs:
                compatible = False
                for from_arch, compat_archs in arch_compat.items():
                    for compat_arch in compat_archs.split():
                        adjusted_archs = [a.replace(from_arch, compat_arch) for a in package_archs]
                        if setup_tune_pkgarch in adjusted_archs:
                            compatible = True

                if not compatible:
                    bb.debug(1, "tcmode-external-oe-sdk: skipping incompatible {}: TUNE_PKGARCH `{}` not found in PACKAGE_ARCHS `{}`".format(setup, setup_tune_pkgarch, package_archs))
                    continue
        candidates.append((setup, setup_env))

    return candidates

def get_setup_script_env(paths, d):
    from pathlib import Path

    setup = d.getVar('EXTERNAL_TOOLCHAIN_SETUP_SCRIPT')
    if setup:
        setup = Path(setup)
        env = parse_setup_script(setup)
    else:
        candidates = select_appropriate_setup_script(d, paths)
        if not candidates:
            setup = None
        elif len(candidates) > 1:
            bb.fatal("tcmode-external-oe-sdk: multiple candidate setup scripts found, please specify with EXTERNAL_TOOLCHAIN_SETUP_SCRIPT: {}".format(" ".join(str(p) for p, e in candidates)))
        else:
            setup, env = candidates[0]
            bb.debug(1, "tcmode-external-oe-sdk: selected setup script {}".format(setup))

    if not setup:
        bb.fatal("tcmode-external-oe-sdk: no compatible toolchain for tuning `{}` found in TOOLCHAIN_PATHS ({})".format(d.getVar("TUNE_PKGARCH"), ", ".join(str(p) for p in paths)))
    return setup, env

def setup_get(setup, field):
    if not field in setup:
        bb.fatal("tcmode-external-oe-sdk: no variable `{}` found in `{}`".format(field, setup))
    return setup[field]

def parse_setup_script(setup):
    import shlex
    import subprocess

    with open(setup, 'r') as f:
        value = f.read()

    values = {}
    for line in value.splitlines():
        if line.split():
            split = shlex.split(line)
            if len(split) == 2 and split[0] == 'export':
                split = split[1:]
            if len(split) == 1:
                try:
                    k, v = split[0].split('=', 1)
                except ValueError:
                    continue
                else:
                    values[k] = v
    return values
```

## meta-external-toolchain/conf/distro/include/tcmode-external.inc
```bitbake
# Configuration to use external Sourcery G++ toolchain
EXTERNAL_TOOLCHAIN ??= "UNKNOWN"
EXTERNAL_TARGET_SYS ??= "${TARGET_ARCH}-${TARGET_OS}"
EXTERNAL_TOOLCHAIN_BIN ??= "${EXTERNAL_TOOLCHAIN}/bin"

# External toolchain features.
#
#   locale-utf8-is-default: assume en_US is utf8, not en_US.UTF-8, as is the
#                           case for OE.
EXTERNAL_TOOLCHAIN_FEATURES ?= ""

python () {
    oe.utils.features_backfill("EXTERNAL_TOOLCHAIN_FEATURES", d)
}

# Prefer our recipes which extract files from the external toolchain
PREFERRED_PROVIDER_virtual/${TARGET_PREFIX}gcc ?= "gcc-external-cross-${TARGET_ARCH}"
PREFERRED_PROVIDER_virtual/${TARGET_PREFIX}gcc-intermediate ?= "gcc-external-cross-${TARGET_ARCH}"
PREFERRED_PROVIDER_virtual/${TARGET_PREFIX}g++ ?= "gcc-external-cross-${TARGET_ARCH}"
PREFERRED_PROVIDER_virtual/${TARGET_PREFIX}binutils ?= "binutils-external-cross-${TARGET_ARCH}"
PREFERRED_PROVIDER_virtual/${TARGET_PREFIX}compilerlibs ?= "gcc-runtime-external"
PREFERRED_PROVIDER_gcc-runtime = "gcc-runtime-external"
PREFERRED_PROVIDER_gcc-sanitizers ?= "gcc-sanitizers-external"
PREFERRED_PROVIDER_libgcc-initial = "libgcc-external"
PREFERRED_PROVIDER_libnsl2 = "libnsl2"
PREFERRED_PROVIDER_libtirpc = "libtirpc"
# PREFERRED_PROVIDER_libgfortran = "libgfortran-external"
PREFERRED_PROVIDER_glibc ?= "glibc-external"
PREFERRED_PROVIDER_virtual/libc ?= "glibc-external"
PREFERRED_PROVIDER_virtual/libintl ?= "glibc-external"
PREFERRED_PROVIDER_virtual/libiconv ?= "glibc-external"
PREFERRED_PROVIDER_virtual/crypt ?= "libxcrypt"
PREFERRED_PROVIDER_gdb-cross-${TARGET_ARCH} ?= "gdb-external-cross-${TARGET_ARCH}"
PREFERRED_PROVIDER_oprofile ??= "oprofile"
# Work around bug where the implicitly created mlprefix preference isn't being
# obeyed for the runtime package installation.
PREFERRED_PROVIDER_${MLPREFIX}gdbserver ?= "${MLPREFIX}gdb"

# This is defined in default-providers.inc, which is parsed before the tcmode,
# so we can't use ?=
PREFERRED_PROVIDER_linux-libc-headers = "glibc-external"
PNBLACKLIST[linux-libc-headers] = "not building with an external toolchain"
PNBLACKLIST[linux-libc-headers-yocto] = "not building with an external toolchain"

PREFERRED_PROVIDER_gcc-cross-canadian-${TRANSLATED_TARGET_ARCH} ??= "gcc-external-cross-canadian-${TRANSLATED_TARGET_ARCH}"
PREFERRED_PROVIDER_binutils-cross-canadian-${TRANSLATED_TARGET_ARCH} ??= "binutils-external-cross-canadian-${TRANSLATED_TARGET_ARCH}"
PREFERRED_PROVIDER_gdb-cross-canadian-${TRANSLATED_TARGET_ARCH} ??= "gdb-external-cross-canadian-${TRANSLATED_TARGET_ARCH}"

# This is defined in default-providers.inc, which is parsed before the tcmode,
# so we can't use ?=
PREFERRED_PROVIDER_libgcc = "libgcc-external"

# Pass --no-sysroot-suffix when using an external toolchain with the SDK
TOOLCHAIN_TARGET_TASK_append = " sdk-env-external-toolchain"

# Sanity check the toolchain configuration and toolchain
INHERIT += "sanity-external-toolchain"

# Pull in our utility functions for use elsewhere
INHERIT += "external-common"

# Ensure that we don't pull in any internal toolchain recipes
INHERIT += "blacklist blacklist_dynamic"
PNBLACKLIST[uclibc] = "not building with an external toolchain"
PNBLACKLIST[glibc] = "not building with an external toolchain"
PNBLACKLIST[glibc-intermediate] = "not building with an external toolchain"
PNBLACKLIST[gcc-runtime] = "not building with an external toolchain"
PNBLACKLIST[gcc-sanitizers] = "not building with an external toolchain"
PNBLACKLIST[gcc-source] = "not building with an external toolchain"
PNBLACKLIST[libgcc-initial] = "not building with an external toolchain"
PNBLACKLIST[libgcc] = "not building with an external toolchain"
PNBLACKLIST[libgfortran] = "not building with an external toolchain"

PNBLACKLIST_DYNAMIC += "\
    ${MLPREFIX}gcc-cross-${TARGET_ARCH} \
    \
    binutils-cross-canadian-${TRANSLATED_TARGET_ARCH} \
    gcc-cross-canadian-${TRANSLATED_TARGET_ARCH} \
    gdb-cross-canadian-${TRANSLATED_TARGET_ARCH} \
    \
    gcc-source-${@'${GCCVERSION}'.replace('%', '')} \
"

# We need our -cross recipes to rebuild when the external toolchain changes,
# to recreate the links / wrapper scripts
BB_HASHBASE_WHITELIST_remove = "EXTERNAL_TOOLCHAIN"

# For a toolchain built with multilibs, we don't want any suffix implicitly
# added to the oe sysroot path, as those dirs will not exist.
# TOOLCHAIN_OPTIONS would seem more appropriate, but that gets added to LD as
# well, and --no-sysroot-suffix only works for gcc, not binutils.
HOST_CC_ARCH += "--no-sysroot-suffix"

# Certain recipes call ld directly, so ensure the correct emulation is used,
# particularly for multilib toolchains, since we can't rely on the default
LDEMULATION = ""
LDEMULATION_ENDIAN = "${@'bt' if 'bigendian' in '${TUNE_FEATURES}'.split() else 'lt'}"
LDEMULATION_BITS = "${@'64' if 'n64' in '${TUNE_FEATURES}'.split() else '32'}"
LDEMULATION_mips64 = "elf${LDEMULATION_BITS}${LDEMULATION_ENDIAN}smip${@bb.utils.contains('TUNE_FEATURES', 'n32', 'n32', '', d)}"
LDEMULATION_x86-64 = "elf_${TARGET_ARCH}"
LDEMULATION_x86-64_linux-gnux32 = "elf32_${TARGET_ARCH}"
TUNE_LDARGS += "${@'-m ${LDEMULATION}' if '${LDEMULATION}' else ''}"

# Additional search path for compiler component programs, to let us rebuild
# binutils if necessary.
gcc_bindir = "${STAGING_BINDIR_TOOLCHAIN}/gcc"
TUNE_CCARGS .= "${@' -B${gcc_bindir}' if d.getVar('PREFERRED_PROVIDER_virtual/${TARGET_PREFIX}binutils') != 'binutils-external-cross-${TARGET_ARCH}' else ''}"

# Align the external toolchain ldflags with the internal
TARGET_LDFLAGS_BUILD_ID = "-Wl,--build-id=sha1"
TARGET_LDFLAGS += "${TARGET_LDFLAGS_BUILD_ID}"

TCMODEOVERRIDES = "tcmode-external"
TCMODEOVERRIDES_append = ":tcmode-${TCMODE}"
OVERRIDES =. "${TCMODEOVERRIDES}:"

python toolchain_metadata_setup () {
    # The external toolchain may not have been built with the yocto preferred
    # gnu hash setting, so ensure that the corresponding sanity check is a
    # warning, not an error.
    error_qa = (d.getVar('ERROR_QA', True) or '').split()
    if 'ldflags' in error_qa:
        error_qa.remove('ldflags')
        d.setVar('ERROR_QA', ' '.join(error_qa))
        d.appendVar('WARN_QA', ' ldflags')
}
toolchain_metadata_setup[eventmask] = "bb.event.ConfigParsed"
addhandler toolchain_metadata_setup

GCCVERSION ?= "${@'.'.join('${GCC_VERSION}'.split('.')[:2])}%"
GCC_VERSION = "${@external_run(d, 'gcc', '-dumpversion').rstrip()}"
GCC_VERSION_allarch = ""
GCC_VERSION[vardepvalue] = "${GCC_VERSION}"

# macro-prefix-map was introduced in gcc 8
REMOVE_MACRO_PREFIX_MAP = "-fmacro-prefix-map=${WORKDIR}=/usr/src/debug/${PN}/${EXTENDPE}${PV}-${PR}"
DEBUG_PREFIX_MAP_remove_class-target = "${@'${REMOVE_MACRO_PREFIX_MAP}' if '${GCC_VERSION}' not in ['', 'UNKNOWN'] and [int(v) for v in '${GCC_VERSION}'.split('.')] < [8,0] else ''}"

BUILDCFG_VARS += "EXTERNAL_TOOLCHAIN EXTERNAL_TARGET_SYS GCC_VERSION"
```
